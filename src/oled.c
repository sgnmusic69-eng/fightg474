#include <stdlib.h>
#include <string.h>

#ifdef __cplusplus
#include <cstdlib>
#include <cstring>
#endif

#include <stdlib.h>
#include <string.h>

#include "oled.h"

#define system_delay_ms(m) delay_cycles((m * (CPUCLK_FREQ / 1000)))

volatile bool gSPIDataTransmitted, gDMATXDataTransferred;

static uint8_t OLED_buffer[1024] = {
    0x00, 0x00, 0x00, 0x00, 0x00, 0x00, 0x00, 0x00, 0x00, 0x00, 0x00, 0x00,
    0x00, 0x00, 0x00, 0x00, 0x00, 0x00, 0x00, 0x00, 0x00, 0x00, 0x00, 0x00,
    0x00, 0x00, 0x00, 0x00, 0x00, 0x00, 0x00, 0x00, 0x00, 0x00, 0x00, 0x00,
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    0x00, 0x00, 0x00, 0x00,
};

void OLED_WR_Byte(unsigned dat, unsigned cmd)
{
    while (DL_SPI_isBusy(SPI_OLED_INST))
        ;
    if (cmd)
        OLED_DC_Set();
    else
        OLED_DC_Clr();
    // OLED_CS_Clr();
    DL_SPI_transmitData8(SPI_OLED_INST, dat);
    // OLED_CS_Set();
}

void OLED_Set_Pos(unsigned char x, unsigned char y)
{
    OLED_WR_Byte(YLevel + y / PAGE_SIZE, OLED_CMD);
    OLED_WR_Byte((((x + 2) & 0xf0) >> 4) | 0x10, OLED_CMD);
    OLED_WR_Byte(((x + 2) & 0x0f), OLED_CMD);
}

void OLED_Display_On(void)
{
    OLED_WR_Byte(0X8D, OLED_CMD); // SET DCDC
    OLED_WR_Byte(0X14, OLED_CMD); // DCDC ON
    OLED_WR_Byte(0XAF, OLED_CMD); // DISPLAY ON
}

void OLED_Display_Off(void)
{
    OLED_WR_Byte(0X8D, OLED_CMD); // SET DCDC
    OLED_WR_Byte(0X10, OLED_CMD); // DCDC OFF
    OLED_WR_Byte(0XAE, OLED_CMD); // DISPLAY OFF
}

/// @brief set one pixel in buffer
/// @param x
/// @param y
/// @param color 0 stands for white while 1 stands for black
void OLED_Set_Pixel(unsigned char x, unsigned char y, unsigned char color)
{
    if (x > 127 || y > 63) // Avoid crossing boundaries
        return;
    if (color)
    {
        OLED_buffer[(y / PAGE_SIZE) * WIDTH + x] |=
            (1 << (y % PAGE_SIZE)) & 0xff;
    }
    else
    {
        OLED_buffer[(y / PAGE_SIZE) * WIDTH + x] &=
            ~((1 << (y % PAGE_SIZE)) & 0xff);
    }
}

/// @brief negation one pixel
/// @param x
/// @param y
void OLED_Reverse_Pixel(uint8_t x, uint8_t y)
{
    if (x > 127 || y > 63) // Avoid crossing boundaries
        return;
    OLED_buffer[(y / PAGE_SIZE) * WIDTH + x] ^= (1 << (y % PAGE_SIZE)) & 0xff;
}

/// @brief write the buffer into screen control IC (using SPI with DMA to
/// accelerate)
/// @param void
void OLED_Display(void)
{
    uint8_t i, n;

    for (i = 0; i < PAGE_SIZE; i++)
    {
        OLED_WR_Byte(YLevel + i, OLED_CMD);
        OLED_WR_Byte(XLevelL, OLED_CMD);
        OLED_WR_Byte(XLevelH, OLED_CMD);
        // for (n = 0; n < WIDTH; n++)
        // {
        //     OLED_WR_Byte(OLED_buffer[i * WIDTH + n], OLED_DATA);
        // }
        while (DL_SPI_isBusy(SPI_OLED_INST))
            ;
        OLED_DC_Set();
        gSPIDataTransmitted = false;
        DL_DMA_setSrcAddr(DMA, DMA_CH1_CHAN_ID,
                          (uint32_t)&OLED_buffer[i * WIDTH]);
        DL_DMA_setDestAddr(DMA, DMA_CH1_CHAN_ID,
                           (uint32_t)(&SPI_OLED_INST->TXDATA));
        DL_DMA_setTransferSize(DMA, DMA_CH1_CHAN_ID, WIDTH);
        DL_DMA_enableChannel(DMA, DMA_CH1_CHAN_ID);
        while (false == gSPIDataTransmitted)
            ;
    } // update full screen
}

/// @brief rewrite all bit in buffer to one specific state
/// @param dat
void OLED_Clear(unsigned dat)
{
    if (dat)
    {
        memset(OLED_buffer, 0xff, sizeof(OLED_buffer));
    }
    else
    {
        memset(OLED_buffer, 0, sizeof(OLED_buffer));
    }
    // OLED_Display();
}

uint8_t brightness;
uint8_t bright_last = 0, tran_sign = 0, tran_speed = 20;

/// @brief fadein and gradually brighten
/// @param x
void OLED_transition(uint8_t x)
{
    if (tran_sign)
    {
        if (x)
        {

            if (bright_last > brightness - tran_speed)
            {
                bright_last = brightness;
                OLED_WR_Byte(0x81, OLED_CMD);
                OLED_WR_Byte(bright_last, OLED_CMD);
                tran_sign = 0;
                return;
            }
            bright_last = bright_last + tran_speed;
            OLED_WR_Byte(0x81, OLED_CMD);
            OLED_WR_Byte(bright_last, OLED_CMD);
        }
        else
        {
            while (1)
            {
                if (bright_last < tran_speed)
                {
                    bright_last = 0;
                    OLED_WR_Byte(0x81, OLED_CMD);
                    OLED_WR_Byte(bright_last, OLED_CMD);
                    break;
                }
                OLED_WR_Byte(0x81, OLED_CMD);
                OLED_WR_Byte(bright_last, OLED_CMD);
                system_delay_ms(16);
                bright_last = bright_last - tran_speed;
            }
            system_delay_ms(16);
            tran_sign = 0;
        }
    }
}

/// @brief reset the OLED (to state before initialized)
/// @param
void OLED_Reset(void)
{
    OLED_RST_Set();
    system_delay_ms(100);
    OLED_RST_Clr();
    system_delay_ms(100);
    OLED_RST_Set();
}

/// @brief actually never needed
/// @param
void OLED_Init_GPIO(void)
{
    DL_GPIO_clearPins(GPIO_OLED_PORT,
                      GPIO_OLED_PIN_DC_PIN | GPIO_OLED_PIN_RES_PIN);
}

/// @brief initialize the OLED
/// @param
void OLED_Init(void)
{
    OLED_Reset();                 // Reset the OLED
    OLED_WR_Byte(0xAE, OLED_CMD); /*display off*/
    OLED_WR_Byte(0x00, OLED_CMD); /*set lower column address*/
    OLED_WR_Byte(0x10, OLED_CMD); /*set higher column address*/
    OLED_WR_Byte(0x40, OLED_CMD); /*set display start line*/
    OLED_WR_Byte(0xB0, OLED_CMD); /*set page address*/
    OLED_WR_Byte(0x81, OLED_CMD); /*contract control*/
    OLED_WR_Byte(0xFF, OLED_CMD); /*128*/
    OLED_WR_Byte(0xA1, OLED_CMD); /*set segment remap*/
    OLED_WR_Byte(0xA6, OLED_CMD); /*normal / reverse*/
    OLED_WR_Byte(0xA8, OLED_CMD); /*multiplex ratio*/
    OLED_WR_Byte(0x3F, OLED_CMD); /*duty = 1/64*/
    OLED_WR_Byte(0xC8, OLED_CMD); /*Com scan direction*/
    OLED_WR_Byte(0xD3, OLED_CMD); /*set display offset*/
    OLED_WR_Byte(0x00, OLED_CMD);
    OLED_WR_Byte(0xD5, OLED_CMD); /*set osc division*/
    OLED_WR_Byte(0x80, OLED_CMD);
    OLED_WR_Byte(0xD9, OLED_CMD); /*set pre-charge period*/
    OLED_WR_Byte(0XF1, OLED_CMD);
    OLED_WR_Byte(0xDA, OLED_CMD); /*set COM pins*/
    OLED_WR_Byte(0x12, OLED_CMD);
    OLED_WR_Byte(0xDB, OLED_CMD); /*set vcomh*/
    OLED_WR_Byte(0x30, OLED_CMD);
    OLED_WR_Byte(0x8D, OLED_CMD); /*set charge pump disable*/
    OLED_WR_Byte(0x14, OLED_CMD);
    OLED_WR_Byte(0xAF, OLED_CMD); /*display ON*/
    NVIC_EnableIRQ(SPI_OLED_INST_INT_IRQN);
}

void SPI_OLED_INST_IRQHandler(void)
{
    switch (DL_SPI_getPendingInterrupt(SPI_OLED_INST))
    {
    case DL_SPI_IIDX_DMA_DONE_TX:
        /* DMA is done transferring data from gTxPacket to TXFIFO */
        gDMATXDataTransferred = true;
        break;
    case DL_SPI_IIDX_TX_EMPTY:
        /* SPI is done transmitting data and TXFIFO is empty */
        gSPIDataTransmitted = true;
        break;
    default:
        break;
    }
}
